## CMakeLists.txt
```
cmake_minimum_required(VERSION 3.20.0)
find_package(Zephyr REQUIRED HINTS $ENV{ZEPHYR_BASE})

project(analog_read_serial_output)

target_sources(app PRIVATE src/main.c)
```

## prj.conf
```kconfig
CONFIG_ADC=y
CONFIG_ADC_NRFX_SAADC=y

CONFIG_SERIAL=y
CONFIG_UART_CONSOLE=y
CONFIG_PRINTK=y
CONFIG_STDOUT_CONSOLE=y
```

## nrf52840dongle_nrf52840.overlay
```dts
/ {
    /* NOTE: this node name must be zephyr,user (comma!) */
    zephyr,user {
        io-channels = <&adc 0>;
    };
};

&adc {
    status = "okay";
    #address-cells = <1>;
    #size-cells = <0>;

    channel@0 {
        reg = <0>;
        zephyr,gain = "ADC_GAIN_1_5";
        zephyr,reference = "ADC_REF_INTERNAL";
        zephyr,acquisition-time = <ADC_ACQ_TIME_DEFAULT>;
        zephyr,resolution = <12>;
        zephyr,input-positive = <NRF_SAADC_AIN0>; /* P0.02 */
        
        //For differential measurement, use input-negative.
        //Note: this will change the adc range to 0-2000 for 0v - 3V
        //zephyr,input-negative = <NRF_SAADC_GND>;
    };
};
```

## src/main.c
```c
#include <zephyr/kernel.h>
#include <zephyr/device.h>
#include <zephyr/drivers/adc.h>
#include <zephyr/devicetree.h>
#include <zephyr/sys/printk.h>
#include <zephyr/sys/util.h>

#if !DT_NODE_EXISTS(DT_PATH(zephyr_user)) || \
    !DT_NODE_HAS_PROP(DT_PATH(zephyr_user), io_channels)
#error "No suitable devicetree overlay specified"
#endif

#define DT_SPEC_AND_COMMA(node_id, prop, idx) \
    ADC_DT_SPEC_GET_BY_IDX(node_id, idx),

static const struct adc_dt_spec adc_channels[] = {
    DT_FOREACH_PROP_ELEM(DT_PATH(zephyr_user), io_channels,
                         DT_SPEC_AND_COMMA)
};

int main(void)
{
    int err;
    int16_t sample;   /* SIGNED buffer */

    struct adc_sequence sequence = {
        .buffer = &sample,
        .buffer_size = sizeof(sample),
    };

    for (size_t i = 0; i < ARRAY_SIZE(adc_channels); i++) {
        if (!adc_is_ready_dt(&adc_channels[i])) {
            printk("ADC %s not ready\n", adc_channels[i].dev->name);
            return 0;
        }

        err = adc_channel_setup_dt(&adc_channels[i]);
        if (err) {
            printk("Channel setup failed (%d)\n", err);
            return 0;
        }
    }

    while (1) {
        for (size_t i = 0; i < ARRAY_SIZE(adc_channels); i++) {
            int32_t mv;

            adc_sequence_init_dt(&adc_channels[i], &sequence);
            err = adc_read_dt(&adc_channels[i], &sequence);
            if (err) {
                printk("adc_read failed (%d)\n", err);
                continue;
            }

            /* sample is already signed */
            mv = sample;

            printk("adc=%d ", sample);

            err = adc_raw_to_millivolts_dt(&adc_channels[i], &mv);
            if (err == 0) {
                printk("mv=%d\n", mv);
            } else {
                printk("(mV unavailable)\n");
            }
        }

        k_sleep(K_MSEC(250));
    }
}
```
