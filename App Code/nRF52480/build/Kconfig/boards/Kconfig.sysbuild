## App Code/nRF52480/build/Kconfig/boards/Kconfig.sysbuild
```kconfig
# Load Sysbuild board Kconfig descriptions.
osource "C:/ncs/v3.1.1/zephyr/boards/nordic/nrf52840dongle/Kconfig.sysbuild"
```

## nRF52840_code/advertise_digital_button/build/Kconfig/boards/Kconfig.sysbuild
```kconfig
# Load Sysbuild board Kconfig descriptions.
osource "C:/ncs/v3.2.1/zephyr/boards/nordic/nrf52840dongle/Kconfig.sysbuild"
```
